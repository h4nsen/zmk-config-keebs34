## boards/shields/keebs34/Kconfig.defconfig
```kconfig
if SHIELD_KEEBS34_LEFT

config ZMK_KEYBOARD_NAME
    default "keebs34"


config ZMK_SPLIT_ROLE_CENTRAL
    default y

endif

if SHIELD_KEEBS34_LEFT || SHIELD_KEEBS34_RIGHT

config ZMK_SPLIT
    default y

config ZMK_PM_SOFT_OFF=y

endif
```

## boards/shields/keebs34/Kconfig.shield
```kconfig
config SHIELD_KEEBS34_LEFT
    def_bool $(shields_list_contains,keebs34_left)

config SHIELD_KEEBS34_RIGHT
    def_bool $(shields_list_contains,keebs34_right)
```
