#include "keebs34.dtsi"

&default_transform { 
    col-offset = <5>;
};

&kscan0 {
    row-gpios = <&pro_micro 21 (GPIO_ACTIVE_HIGH)>
                , <&pro_micro 18 (GPIO_ACTIVE_HIGH)>
                , <&pro_micro 14 (GPIO_ACTIVE_HIGH)>
                , <&pro_micro 9 (GPIO_ACTIVE_HIGH)>;

    col-gpios = <&pro_micro 19 (GPIO_ACTIVE_HIGH | GPIO_PULL_DOWN)>
                , <&pro_micro 1 (GPIO_ACTIVE_HIGH | GPIO_PULL_DOWN)>
                , <&pro_micro 20 (GPIO_ACTIVE_HIGH | GPIO_PULL_DOWN)>
                , <&pro_micro 15 (GPIO_ACTIVE_HIGH | GPIO_PULL_DOWN)>
                , <&pro_micro 10 (GPIO_ACTIVE_HIGH | GPIO_PULL_DOWN)>
};

&pinctrl {
    spi0_default: spi0_default {
        group1 {
            psels = <NRF_PSEL(SPIM_SCK, 0, 11)>,
                    <NRF_PSEL(SPIM_MOSI, 1, 04)>;
        };
    };

    spi0_sleep: spi0_sleep {
        group1 {
            psels = <NRF_PSEL(SPIM_SCK, 0, 11)>,
                    <NRF_PSEL(SPIM_MOSI, 1, 04)>;
            low-power-enable;
        };
    };
};

nice_view_spi: &spi0 {
    compatible = "nordic,nrf-spim";
    pinctrl-0 = <&spi0_default>;
    pinctrl-1 = <&spi0_sleep>;
    pinctrl-names = "default", "sleep";
    cs-gpios = <&pro_micro 16 GPIO_ACTIVE_HIGH>; //nice!nano 014
    status = "okay";
};